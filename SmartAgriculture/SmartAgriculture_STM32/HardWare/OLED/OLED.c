#include "stm32f10x.h"

#include "OLED.h"
#include "Delay.h"
#include "Key.h"
#include "DHT11.h"
#include "AD.h"
#include "AutoControl.h"
#include "SGP30.h"
#include "LED.h"
#include "buzzer.h"
#include "Servo.h"
#include "relay.h"

u8g2_t u8g2;

char text1[30];

//main界面图片
const uint8_t LOGO[]=
{
0x00,0x00,0x00,0x00,0x00,0x00,0x00,0x00,0x00,0x00,0x00,0x00,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0x06,
0xC3,0x1F,0x00,0x00,0x60,0x33,0x03,0xC3,0xC0,0xFF,0x03,0x66,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0x66,
0x83,0x19,0xE3,0xFF,0x83,0x3F,0x00,0x00,0xC0,0xFC,0x03,0xC3,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0xFF,
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0x00,0x00,0x00,0x00
};

uint8_t disappear_step=1;

float angle,angle_last;
//实时坐标
//uint8_t chart_x;
bool frame_is_drawed=false;

//指向buf首地址的指针
uint8_t* buf_ptr;
uint16_t buf_len;


//选择界面变量
uint8_t x;
int16_t y,y_trg;//目标和当前
uint8_t line_y,line_y_trg;//线的位置
uint8_t box_width,box_width_trg;//框的宽度
int16_t box_y,box_y_trg;//框的当前值和目标值
int8_t ui_select;//当前选中那一栏

//pid界面变量
int16_t pid_y,pid_y_trg;
uint8_t pid_line_y,pid_line_y_trg;//线的位置
uint8_t pid_box_width,pid_box_width_trg;//框的宽度
int16_t pid_box_y,pid_box_y_trg;//框的当前值和目标值
int8_t pid_select;//当前选中那一栏


//icon界面变量
int16_t icon_x,icon_x_trg;
int16_t app_y,app_y_trg;
int8_t icon_select;
uint8_t ui_index,ui_state;

//显示
int16_t chart_x,chart_x_trg;


enum//ui_index
{
  M_LOGO,//开始界面
  M_SELECT,//选择界面
  M_PID,//PID界面
  M_PID_EDIT,//pid编辑
  M_ICON,//icon界面
  M_CHART,//图表
  M_TEXT_EDIT,//文字编辑
  M_VIDEO,//视频显示
  M_ABOUT,//关于本机 
};

enum//ui_state
{
  S_NONE,
  S_DISAPPEAR,
  S_SWITCH,
  S_MENU_TO_MENU,
  S_MENU_TO_PIC,
  S_PIC_TO_MENU, 
};

//菜单结构体
typedef struct
{
  char * select;
}SELECT_LIST;

SELECT_LIST pid[] = 
{
  {"-tempControl"},
  {"-soilHumControl"},
  {"-lightControl"},
  {"-Co2Control"},
  {"Return"},
};

uint8_t pid_num=sizeof(pid)/sizeof(SELECT_LIST);//PID选项数量

SELECT_LIST list[] = 
{
  {"MainUI"},
  {"+AUTO Editor"},
  {"-Switch Seting"},
  {"-Value Display"},
  {"{ About }"},
};

uint8_t list_num = sizeof(list)/sizeof(SELECT_LIST);//选择界面数量
uint8_t single_line_length;//赋值在主函数中
uint8_t total_line_length;

SELECT_LIST icon[] = 
{
  {"LED1"},
  {"Buzzer"},
  {"Servo"},
  {"Fan"},
  {"Wpump"},
  {"Auto"},
  {"Return"},
};
uint8_t icon_num=sizeof(icon)/sizeof(SELECT_LIST);

uint8_t icon_width[]={36,36,36,36,36,36,36};

const uint8_t icon_pic[][200] = 
{
  {
    0x00,0x00,0x06,0x00,0x00,0x00,0x00,0x06,0x00,
	 0x00,0x00,0x00,0x06,0x00,0x00,0x00,0x00,0x06,
	 0x00,0x00,0x80,0x01,0x06,0x0C,0x00,0x80,0x03,
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	 0x00,0x00,0x00,0x00
    /* LED灯(36 X 36 )*/
  },
  {
   0x00,0x00,0x00,0x00,0x00,0x00,0x00,0x00,0x00,
	0x00,0x00,0x00,0x00,0x00,0x00,0x00,0x00,0x00,
	0x00,0x00,0x00,0x00,0x00,0x00,0x00,0x00,0x00,
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	0x00,0x00,0x00,0x00
    /* 蜂鸣器(36 X 36 )*/
  },
  {
	0x00,0x00,0x00,0x00,0x00,0xC0,0x3C,0x06,
	0x00,0x00,0xF0,0xFF,0x07,0x00,0x00,0x30,
	0xC3,0x0D,0x00,0x00,0x30,0x00,0x0C,0x00,
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	0x00,0x00,0xE0,0x3C,0x07,0x00,0x00 
    /* 舵机(36 X 36 )*/
  },
  {
	0x00,0x00,0x00,0x00,0x00,0x00,0x00,0x00,
	0x00,0x00,0x00,0x00,0x00,0x00,0x00,0x00,
	0x00,0x00,0x00,0x00,0x00,0xF8,0x00,0x00,
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	0x00,0x00,0x00,0x00,0x00,0x00,0x00
	/* 风扇(36 X 36 )*/
  },
  {
	0x00,0x00,0x00,0x00,0x00,0x00,0x00,0x00,0x00,0x00,0x00,0x00,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0x00,
	0x08,0xCD,0xFD,0x03,0x06,0xDE,0x0F,0x0D,0x02,0x07,0x0A,0x0D,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0x04,
	0xC0,0x00,0x30,0x18,0x04,0xC0,0x00,0x50,0x10,0x07,0x80,0x00,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0x00
	  /* 水泵(36 X 36 )*/
  },
  {
	0x00,0xF0,0xFF,0x00,0x00,0x00,0xF8,0xFF,
	0x03,0x00,0x00,0xFC,0xFF,0x03,0x00,0x00,
	0x1C,0x00,0x07,0x00,0x00,0x0E,0x00,0x0F,
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	0xFF,0xFF,0x07,0xFC,0xFF,0xFF,0xFF,0x03
	  /* Auto(36 X 36 )*/
  },
  {
    0x00,0x00,0x00,0x00,0x00,0x00,0x00,0x00,
    0x00,0x00,0x00,0x00,0x00,0x00,0x00,0x00,
    0x00,0x0C,0x00,0x00,0x00,0x00,0x1C,0x00,
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    0x00,0x00,0x00,0x00
	 /* 返回(36 X 36 )*/
  },
  
};

//设置延时和引脚高低电平操作函数
uint8_t u8g2_gpio_and_delay_stm32(U8X8_UNUSED u8x8_t *u8x8, U8X8_UNUSED uint8_t msg, U8X8_UNUSED uint8_t arg_int, U8X8_UNUSED void *arg_ptr)
{
	switch(msg)
	{
		case U8X8_MSG_DELAY_MILLI://Function which implements a delay, arg_int contains the amount of ms
		Delay_ms(arg_int);
		break;
		
		case U8X8_MSG_DELAY_10MICRO: //Function which delays 10us
		Delay_us(10);
		break;
		
		case U8X8_MSG_DELAY_100NANO://Function which delays 100ns
		__NOP();
		break;
		
		//函数来定义时钟线的逻辑电平
		
		case U8X8_MSG_GPIO_I2C_CLOCK:
			if (arg_int) OLED_W_SCL(1);
			else OLED_W_SCL(0);
		break;
		
		case U8X8_MSG_GPIO_I2C_DATA:
			if (arg_int) OLED_W_SDA(1);
			else OLED_W_SDA(0);
		break;
		
		default:
			return 0; //A message was received which is not implemented, return 0 to indicate an error
	}

	return 1; // command processed successfully.
}


//总初始化
void u8g2Init(void)
{
   //u8g2初始化
	//U8G2_R0表示屏幕方向
	OLED_I2C_Init();
	u8g2_Setup_ssd1306_i2c_128x64_noname_f(&u8g2, U8G2_R0, u8x8_byte_sw_i2c, u8g2_gpio_and_delay_stm32);
	u8g2_InitDisplay(&u8g2); // 发送初始化序列到显示器，在此之后显示器处于休眠模式;
   u8g2_SetPowerSave(&u8g2, 0); // 唤醒显示wake up display
	Delay_ms(1000);
	u8g2_ClearBuffer(&u8g2);//清除缓存
	u8g2_SetFont(&u8g2,u8g2_font_wqy12_t_chinese1);
		//选择界面数量
	uint8_t single_line_length = 63 / list_num;
	uint8_t total_line_length = single_line_length*list_num+1;

	buf_ptr=u8g2_GetBufferPtr(&u8g2);//拿到buffer首地址
   buf_len=8*u8g2_GetBufferTileHeight(&u8g2)*u8g2_GetBufferTileWidth(&u8g2);
	x=4;
	y=y_trg=0;
	chart_x = chart_x_trg = 0;
	pid_y = pid_y_trg = 0;
	line_y=line_y_trg=1;
	pid_line_y=pid_line_y_trg=1;
	ui_select=pid_select=icon_select=0;
	icon_x=icon_x_trg=0;
	app_y=app_y_trg=0;
	box_width=box_width_trg=u8g2_GetStrWidth(&u8g2,list[ui_select].select)+x*2;//两边各多2
	pid_box_width=pid_box_width_trg=u8g2_GetStrWidth(&u8g2,pid[pid_select].select)+x*2;//两边各多2
	ui_index=M_LOGO;
	ui_state=S_NONE;
}


/*引脚初始化*/
void OLED_I2C_Init(void)
{
  RCC_APB2PeriphClockCmd(OLED_SDA_Clock, ENABLE);
	GPIO_InitTypeDef GPIO_InitStructure;
 	GPIO_InitStructure.GPIO_Mode = GPIO_Mode_Out_OD;//_PP
	GPIO_InitStructure.GPIO_Speed = GPIO_Speed_50MHz;
	GPIO_InitStructure.GPIO_Pin = OLED_SCL_Pin;
 	GPIO_Init(OLED_SCL_GPIO, &GPIO_InitStructure);
	GPIO_InitStructure.GPIO_Pin = OLED_SDA_Pin;
 	GPIO_Init(OLED_SDA_GPIO, &GPIO_InitStructure);
	
	OLED_W_SCL(1);
	OLED_W_SDA(1);
}

//移动函数
bool move(int16_t* a,int16_t* a_trg)
{
  if (*a < *a_trg)
  {
    *a+=SPEED;
    if (*a>*a_trg) *a=*a_trg;//加完超过
  }
  else if(*a>*a_trg)
  {
    *a-=SPEED;
    if (*a<*a_trg) *a=*a_trg;//减完不足
  }
  else
  {
    return true;//到达目标
  }
  return false;//未到达
}


//移动函数
bool move_icon(int16_t* a,int16_t* a_trg)
{
  if (*a < *a_trg)
  {
    *a+=ICON_SPEED;
    if (*a>*a_trg) *a=*a_trg;//加完超过
  }
  else if(*a>*a_trg)
  {
    *a-=ICON_SPEED;
    if (*a<*a_trg) *a=*a_trg;//减完不足
  }
  else
  {
    return true;//到达目标
  }
  return false;//未到达
}

//宽度移动函数
bool move_width(uint8_t* a,uint8_t* a_trg,uint8_t select,uint8_t id)
{
  if (*a < *a_trg)
  {
    uint8_t step=16/SPEED;//判断步数
    uint8_t len;
    if(ui_index==M_SELECT)
    {
    len=abs(u8g2_GetStrWidth(&u8g2,list[select].select)-u8g2_GetStrWidth(&u8g2,list[id==0?select+1:select-1].select));
    }
    else if(ui_index==M_PID)
    {
    len=abs(u8g2_GetStrWidth(&u8g2,pid[select].select)-u8g2_GetStrWidth(&u8g2,pid[id==0?select+1:select-1].select));
    }
    uint8_t width_speed=((len%step)==0?(len/step):(len/step+1));   //计算步长
    *a+=width_speed;
    if (*a>*a_trg) *a=*a_trg;//
  }
  else if(*a>*a_trg)
  {
    uint8_t step=16/SPEED;//判断步数
    uint8_t len;
    if(ui_index==M_SELECT)
    {
    len=abs(u8g2_GetStrWidth(&u8g2,list[select].select)-u8g2_GetStrWidth(&u8g2,list[id==0?select+1:select-1].select));
    }
    else if(ui_index==M_PID)
    {
    len=abs(u8g2_GetStrWidth(&u8g2,pid[select].select)-u8g2_GetStrWidth(&u8g2,pid[id==0?select+1:select-1].select));
    }
    uint8_t width_speed=((len%step)==0?(len/step):(len/step+1));   //计算步长
    *a-=width_speed;
    if (*a<*a_trg) *a=*a_trg;
  }
  else
  {
    return true;//到达目标
  }
  return false;//未到达
}

//进度条移动函数
bool move_bar(uint8_t* a,uint8_t* a_trg)
{
  if (*a < *a_trg)
  {
    uint8_t step=16/SPEED;//判断步数
    uint8_t width_speed=((single_line_length%step)==0?(single_line_length/step):(single_line_length/step+1));   //计算步长
    *a+=width_speed;
    if (*a>*a_trg) *a=*a_trg;//
  }
  else if(*a>*a_trg)
  {
    uint8_t step=16/SPEED;//判断步数
    uint8_t width_speed=((single_line_length%step)==0?(single_line_length/step):(single_line_length/step+1));   //计算步长
    *a-=width_speed;
    if (*a<*a_trg) *a=*a_trg;
  }
  else
  {
    return true;//到达目标
  }
  return false;//未到达
}

//消失函数
void disappear()
{
  switch(disappear_step)
  {
    case 1:
    for(uint16_t i=0;i<buf_len;++i)
    {
      if(i%2==0) buf_ptr[i]=buf_ptr[i] & 0x55;
    }
    break;
    case 2:
    for(uint16_t i=0;i<buf_len;++i)
    {
      if(i%2!=0) buf_ptr[i]=buf_ptr[i] & 0xAA;
    }
    break;
    case 3:
    for(uint16_t i=0;i<buf_len;++i)
    {
      if(i%2==0) buf_ptr[i]=buf_ptr[i] & 0x00;
    }
    break;
    case 4:
    for(uint16_t i=0;i<buf_len;++i)
    {
      if(i%2!=0) buf_ptr[i]=buf_ptr[i] & 0x00;
    }
    break;
    default:
    ui_state=S_NONE;
    disappear_step=0;
    break;
  }
  disappear_step++;
}

void logo_ui_show()//显示logo
{
  u8g2_DrawXBMP(&u8g2,0, 0, 128, 64, LOGO);
}

void select_ui_show()//选择界面
{
  move_bar(&line_y,&line_y_trg);
  move(&y,&y_trg);
  move(&box_y,&box_y_trg);
  move_width(&box_width,&box_width_trg,ui_select,key_msg.id);
  u8g2_DrawVLine(&u8g2,126,0,total_line_length);
  u8g2_DrawPixel(&u8g2,125,0);
  u8g2_DrawPixel(&u8g2,127,0);
  for(uint8_t i=0;i<list_num;++i)
  {    
    u8g2_DrawStr(&u8g2,x,16*i+y+12,list[i].select);  // 第一段输出位置 
    u8g2_DrawPixel(&u8g2,125,single_line_length*(i+1));
    u8g2_DrawPixel(&u8g2,127,single_line_length*(i+1));
  }
  u8g2_DrawVLine(&u8g2,125,line_y,single_line_length-1);
  u8g2_DrawVLine(&u8g2,127,line_y,single_line_length-1);
  u8g2_SetDrawColor(&u8g2,2);
  u8g2_DrawRBox(&u8g2,0,box_y,box_width,16,1);
  u8g2_SetDrawColor(&u8g2,1);
}


void pid_ui_show()//PID界面
{
  move(&pid_y,&pid_y_trg);//后加的
  move_bar(&pid_line_y,&pid_line_y_trg);
  move(&pid_box_y,&pid_box_y_trg);
  move_width(&pid_box_width,&pid_box_width_trg,pid_select,key_msg.id);
  u8g2_DrawVLine(&u8g2,126,0,61);
  u8g2_DrawPixel(&u8g2,125,0);
  u8g2_DrawPixel(&u8g2,127,0);
  for(uint8_t i=0;i<pid_num;++i)
  {    
    u8g2_DrawStr(&u8g2,x,16*i+pid_y+12,pid[i].select);  // 第一段输出位置 
    u8g2_DrawPixel(&u8g2,125,15*(i+1));
    u8g2_DrawPixel(&u8g2,127,15*(i+1));
  }

  u8g2_SetDrawColor(&u8g2,2);
  u8g2_DrawRBox(&u8g2,0,pid_box_y,pid_box_width,16,1);
  u8g2_SetDrawColor(&u8g2,1);
  u8g2_DrawVLine(&u8g2,125,pid_line_y,14);
  u8g2_DrawVLine(&u8g2,127,pid_line_y,14);
  u8g2_SendBuffer(&u8g2);
}


void about_ui_show()//about界面
{

  u8g2_DrawStr(&u8g2,2,12,"Project : SmartAgriculture");
  u8g2_DrawStr(&u8g2,2,28,"MCU : STM32");
  u8g2_DrawStr(&u8g2,2,44,"Version : 1.0");
  u8g2_DrawStr(&u8g2,2,60,"ID : 542007130418");
	u8g2_SendBuffer(&u8g2);
}

void logo_proc()//logo界面处理函数
{
  if(key_msg.pressed)
  {
    key_msg.pressed=false;
    ui_state=S_DISAPPEAR;
    ui_index=M_SELECT;
  }
  logo_ui_show();
}

void select_proc(void)//选择界面处理
{
  if(key_msg.pressed)
  {
    key_msg.pressed=false;
    switch(key_msg.id)
    {
      case 0:
      if(ui_select<1) break;
      ui_select-=1;
      line_y_trg-=single_line_length;
      if(ui_select<-(y/16))
      {
        y_trg+=16;
      }
      else
      {
        box_y_trg-=16;   
      }
 
      break;
      case 1:
      if((ui_select+2)>(sizeof(list)/sizeof(SELECT_LIST))) break;
      ui_select+=1;
      line_y_trg+=single_line_length;
      if((ui_select+1)>(4-y/16))
      {
        y_trg-=16;
      }
      else
      {
        box_y_trg+=16; 
      }

      break;
      case 2:
      switch(ui_select)
      {
        case 0:     //return
        ui_state=S_DISAPPEAR;
        ui_index=M_LOGO;
        break;
        case 1:     //pid
        ui_state=S_DISAPPEAR;
        ui_index=M_PID;
		  
        break;
        case 2:   //icon
        ui_state=S_DISAPPEAR;
        ui_index=M_ICON;
        break;
        case 3:   //chart
        ui_state=S_DISAPPEAR;
        ui_index=M_CHART;
        break;
        case 5:   //textedit
        ui_state=S_DISAPPEAR;
        ui_index=M_TEXT_EDIT;
        break;
        case 4:   //about
        ui_state=S_DISAPPEAR;
        ui_index=M_ABOUT;
        break;
        default:
        break;
      }
      default:
      break;
    }
    box_width_trg=u8g2_GetStrWidth(&u8g2,list[ui_select].select)+x*2;
  }
  select_ui_show();
}

void about_proc()//about界面处理函数
{
  if(key_msg.pressed)
  {
    key_msg.pressed=false;
    ui_state=S_DISAPPEAR;
    ui_index=M_SELECT;
  }
  about_ui_show();
}


void chart_ui_show()//chart界面
{
	u8g2_ClearBuffer(&u8g2);
	move(&chart_x,&chart_x_trg);
	sprintf(text1,"SoilHum : %d",AD_Value[1]);
	u8g2_DrawStr(&u8g2,chart_x,12,text1);
	sprintf(text1,"Light : %d",AD_Value[0]);
	u8g2_DrawStr(&u8g2,chart_x,28,text1);
	sprintf(text1,"Hum :  %d.%d",DHT_Buffer[0],DHT_Buffer[1]);
	u8g2_DrawStr(&u8g2,chart_x,44,text1);
	sprintf(text1,"Temp : %d.%d C",DHT_Buffer[2],DHT_Buffer[3]);
	u8g2_DrawStr(&u8g2,chart_x,60,text1);
	//第二个显示页面
	sprintf(text1,"TVOC : %d",TVOC);
	u8g2_DrawStr(&u8g2,chart_x+128,12,text1);
	sprintf(text1,"Co2 : %d Ppm",Co2);
	u8g2_DrawStr(&u8g2,chart_x+128,28,text1);
}

void chart_proc()//chart界面处理函数
{
  
  if(key_msg.pressed)
  {
    key_msg.pressed=false;
	  switch(key_msg.id)
    {
      case 0: 
			chart_x_trg = 0;
			break;
		case 1: 
			chart_x_trg = -128;
			break;
		case 2: 
			ui_state=S_DISAPPEAR;
			ui_index=M_SELECT;
			break;
		default:
		break;
			
	 }
    
  }
  chart_ui_show();
}

void pid_proc()//pid界面处理函数
{
pid_ui_show();
if(key_msg.pressed)
  {  
    key_msg.pressed=false;
    switch(key_msg.id)
    {
      case 0:
			
      if(pid_select != 0) 
      {
			pid_select-=1;
			if(pid_y_trg != 0 && pid_select < pid_num - 4)
			{
				pid_y_trg +=16;	
			}
			else
			{
				pid_line_y_trg-=15;
			   pid_box_y_trg-=16;  
			}
			 
      break;
      }
      else
      {
        break;
      }
		break;
		
		
      case 1:
			
		if(pid_select < (pid_num - 1))
      { 
        pid_select+=1;
        
		  if(pid_select > 3)
		  {
			 pid_y_trg -=16;	
		  }else
		  {
			 pid_line_y_trg+=15;
          pid_box_y_trg+=16; 
		  }	
      }
      else
      {
        break;
      }
		break;	
			
	
      case 2:
      if(pid_select== (pid_num - 1))
      {
		  pid_y = 0;//测试
		  pid_y_trg = 0;	
        ui_index=M_SELECT;
        ui_state=S_DISAPPEAR;
        pid_select=0;
        pid_line_y=pid_line_y_trg=1;
        pid_box_y=pid_box_y_trg=0;
        pid_box_width=pid_box_width_trg=u8g2_GetStrWidth(&u8g2,pid[pid_select].select)+x*2;
      }
      else
      {
        ui_index=M_PID_EDIT;
      }
      break;
      default:
      break;
    }
    pid_box_width_trg=u8g2_GetStrWidth(&u8g2,pid[pid_select].select)+x*2;
  }
}

void pid_edit_ui_show()//显示PID编辑
{
  switch(pid_select)
  {
    case 0:
		sprintf(text1,"TempValue : %d.%d C",DHT_Buffer[2],DHT_Buffer[3]);
		u8g2_DrawStr(&u8g2,0,10,text1);
		sprintf(text1,"---->tempControl : %d",tempControl.ENV_MaxValue);
		u8g2_DrawStr(&u8g2,0,30,text1);
    break;
    case 1:
		sprintf(text1,"SoilHumValue : %d",AD_Value[1]); 
		u8g2_DrawStr(&u8g2,0,10,text1);
		sprintf(text1,"---->SOHControl : %d",soilHumControl.ENV_MaxValue);
		u8g2_DrawStr(&u8g2,0,30,text1);
    break;
    case 2:
		sprintf(text1,"LightValue : %d",AD_Value[0]);
	   u8g2_DrawStr(&u8g2,0,10,text1);
		sprintf(text1,"---->lightControl : %d",lightControl.ENV_MaxValue); 
		u8g2_DrawStr(&u8g2,0,30,text1);
	 break;
	 case 3:
		sprintf(text1,"---->Co2Value : %d",Co2);  
	   u8g2_DrawStr(&u8g2,0,10,text1);
		sprintf(text1,"---->Co2Control : %d",Co2Control.ENV_MaxValue);  
	   u8g2_DrawStr(&u8g2,0,30,text1);
    break;
    default:
    break;
  }

}

void pid_edit_proc(void)//pid编辑界面处理函数
{
  if(key_msg.pressed)
  {
    key_msg.pressed=false;
    switch(key_msg.id)
    {
      case 0:
			  switch(pid_select)
			  {
				 case 0:
					tempControl.ENV_MaxValue--;
				 break;
				 case 1:
					soilHumControl.ENV_MaxValue -= 100;
				 break;
				 case 2:
					lightControl.ENV_MaxValue -= 100;
				 break;
				 case 3:
					Co2Control.ENV_MaxValue -= 10;
				 break;
				 default:
				 break;
			  }
		   
      break;
      case 1:
			switch(pid_select)
		  {
			 case 0:
				tempControl.ENV_MaxValue++;
			 break;
			 case 1:
				soilHumControl.ENV_MaxValue += 100;
			 break;
			 case 2:
				lightControl.ENV_MaxValue += 100;
			 break;
			 case 3:
				Co2Control.ENV_MaxValue += 10;
			 break;
			 default:
			 break;
		  }
      break;
      case 2:
      ui_index=M_PID;
      break;
      default:
      break;
    }
  }
  //pid_ui_show();
  for(uint16_t i=0;i<buf_len;++i)
  {
    buf_ptr[i]=buf_ptr[i] & (i%3==0?0x55:0xAA);
  }
  pid_edit_ui_show();
}

void icon_ui_show(void)//显示icon
{
  move_icon(&icon_x,&icon_x_trg);
  move(&app_y,&app_y_trg);
	
  for(uint8_t i=0;i<icon_num;++i)
  {
	 u8g2_DrawXBMP(&u8g2,46+icon_x+i*ICON_SPACE,6,36,icon_width[i],icon_pic[i]);
    u8g2_SetClipWindow(&u8g2,0, 48,128 , 64 );
    u8g2_DrawStr(&u8g2,(128-u8g2_GetStrWidth(&u8g2,icon[i].select))/2,62-app_y+i*16,icon[i].select);
	 if(icon_select == 5)
	 {
		if(AutoControl_mode == 1)
		{
			sprintf(text1,": ON");
		}
		else{
			sprintf(text1,": OFF");
		}  
		u8g2_DrawStr(&u8g2,(128-u8g2_GetStrWidth(&u8g2,icon[i].select))/2 + 30,(62-app_y+i*16) ,text1); 
	 }
	 
    u8g2_SetMaxClipWindow(&u8g2);
  }

}


void icon_proc(void)//icon界面处理
{
  icon_ui_show();
    if(key_msg.pressed)
  {
    key_msg.pressed=false;
    switch(key_msg.id)
    { 
      case 1:
      if(icon_select!=(icon_num-1)) 
      {
        icon_select+=1;
        app_y_trg+=16;
        icon_x_trg-=ICON_SPACE;
      }
      break;
      case 0:
      if(icon_select!=0) 
      {
        icon_select-=1;
        app_y_trg-=16;
        icon_x_trg+=ICON_SPACE;
      }
      break;
      case 2:
		switch(icon_select)
		{
			case 0:
				LED2_Turn();
				lightControl.ENV_free = Free_Value;
				break;
			case 1:
				Buzzer_Turn();
				tempControl.ENV_free = Free_Value;
				break;
			case 2:
				Servo_Turn();
				Co2Control.ENV_free = Free_Value;
				break;
			case 3:
				relay1_Turn();
				Co2Control.ENV_free = Free_Value;
				break;
			case 4:
				relay2_Turn();
				soilHumControl.ENV_free = Free_Value;
				break;
			case 5:
				if(AutoControl_mode == 1)
				{
					
					AutoControl_mode = 0;	
				}
				else
				{
					tempControl.ENV_free = 0;		
					soilHumControl.ENV_free = 0;							
					lightControl.ENV_free = 0;							
					Co2Control.ENV_free = 0;
					AutoControl_mode = 1;
				}
				break;
			case 6:
				ui_state=S_DISAPPEAR;
				ui_index=M_SELECT;
				icon_select=0;
				icon_x=icon_x_trg=0;
				app_y=app_y_trg=0;
				break;
		}
      break;
      default:
      break;
    }
  }
}

void ui_proc()//总的UI进程
{
  switch(ui_state)
  {
    case S_NONE:
    if(ui_index!=M_CHART) u8g2_ClearBuffer(&u8g2);
    switch(ui_index)
    {
      case M_LOGO:
      logo_proc();
      break;
      case M_SELECT:
      select_proc();
      break;
      case M_PID:
      pid_proc();
      break;
      case M_ICON:
      icon_proc();
      break;
      case M_CHART:
      chart_proc();
      break;
      case M_TEXT_EDIT:
      //text_edit_proc();
      break;
      case M_PID_EDIT:
      pid_edit_proc();
      break;
      case M_ABOUT:
      about_proc();
      break;
      default:
      break;
    }
    break;
    case S_DISAPPEAR:
    disappear();
    break;
    default:
    break;
  }
  u8g2_SendBuffer(&u8g2);
} 



